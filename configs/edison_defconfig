## configs/edison_defconfig
```kconfig
CONFIG_X86=y
CONFIG_MMC=y
CONFIG_VENDOR_INTEL=y
CONFIG_DEFAULT_DEVICE_TREE="edison"
CONFIG_TARGET_EDISON=y
CONFIG_CMD_CPU=y
# CONFIG_CMD_IMLS is not set
# CONFIG_CMD_FLASH is not set
# CONFIG_CMD_SETEXPR is not set
# CONFIG_CMD_NFS is not set
CONFIG_CMD_BOOTEFI=y
CONFIG_CMD_INI=y
CONFIG_OF_CONTROL=y
CONFIG_OF_EMBED=y
CONFIG_PCI=y
CONFIG_DM_PCI=y
CONFIG_DM_PCI_COMPAT=y
CONFIG_DM_RTC=y
CONFIG_EFI_LOADER=y
CONFIG_USE_PRIVATE_LIBGCC=y
CONFIG_SHA1=y
CONFIG_SYS_VSNPRINTF=y
CONFIG_HUSH_PARSER=y
CONFIG_INTEL_SCU=y
CONFIG_SYS_NS16550=y
CONFIG_CPU=y
CONFIG_MMC_SDHCI=y
CONFIG_MMC_SDHCI_SDMA=y
CONFIG_TANGIER_SDHCI=y
CONFIG_USB_FUNCTION_DFU=y
CONFIG_CMD_DFU=y
CONFIG_DFU_MMC=y
CONFIG_DFU_RAM=y
CONFIG_RTC_MC146818=y
CONFIG_TIMER=y
CONFIG_REGMAP=y
CONFIG_SYSCON=y
```

## drivers/watchdog/Kconfig
```kconfig
menu "WATCHDOG support"

config TANGIER_WATCHDOG
	bool "Intel Tangier watchdog"
	depends on INTEL_MID
	help
	  This enables support for watchdog controller available on
	  Intel Tangier SoC. If you're using a board with Intel Tangier
	  SoC, say Y here.

config ULP_WATCHDOG
	bool "i.MX7ULP watchdog"
	help
	  Say Y here to enable i.MX7ULP watchdog driver.

endmenu
```
